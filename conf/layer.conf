## conf/layer.conf
```bitbake
LAYERSERIES_COMPAT_osmio4kplus = "zeus"

# We have a conf and classes directory, append to BBPATH
BBPATH .= ":${LAYERDIR}"

# We have a recipes directory containing .bb and .bbappend files, add to BBFILES
BBFILES += "${LAYERDIR}/recipes*/*/*.bb \
	    ${LAYERDIR}/recipes*/*/*/*.bb \
            ${LAYERDIR}/recipes*/*/*.bbappend"

BBFILE_COLLECTIONS += "osmio4kplus"
BBFILE_PATTERN_osmio4kplus := "^${LAYERDIR}/"
BBFILE_PRIORITY_osmio4kplus = "6"

# Additional license settings
LICENSE_PATH += "${LAYERDIR}/files/custom-licenses"
LICENSE_PATH += "${YOCTO_BASEDIR}/meta-neutrino/custom-licenses"
LICENSE_FLAGS_WHITELIST = "commercial"
```

## conf/machine/include/edision/edision-arm.inc
```bitbake
# eMMC has 8 GB in total, but one image gets only 2 GB of that (Partitioned eMMC)
FLASHSIZE = "2048"

BRAND_OEM = "edision"
MACHINE_BRAND = "Edision"
MACHINE_NAME = "${MACHINE}"

MTD_ROOTFS = "mmcblk1p3"
MTD_KERNEL = "mmcblk1p2"
KERNEL_FILE = "kernel.bin"
KERNEL_OUTPUT = "${KERNEL_IMAGETYPE}"
KERNEL_CONSOLE = "ttyS0,115200n8"
ROOTFS_FILE = "rootfs.tar.bz2"
IMAGEDIR = "${MACHINE}"
IMAGE_CLASSES += "osmio4k-emmcimg_multiboot"
IMAGE_FSTYPES ?= "osmio-emmc"
IMAGE_OVERHEAD_FACTOR = "1.0"

DISTRO_FEATURES_append += "bluez5 pulseaudio"

PACKAGECONFIG_GL_pn-qtbase = "gles2 eglfs linuxfb"
PACKAGECONFIG_FB_pn-qtbase = " "

MACHINE_FEATURES_BACKFILL_CONSIDERED = "rtc"


MACHINE_ESSENTIAL_EXTRA_RDEPENDS += "\
    edision-dvb-modules-${MACHINE} \
"    

BOOTLOGO_FILENAME = "splash.bin"

# arm
DEFAULTTUNE = "armv7vehf-neon-vfpv4"
KERNEL_IMAGETYPE = "zImage"

## arm64
#DEFAULTTUNE = "aarch64"
#KERNEL_IMAGETYPE = "Image.gz"

require conf/machine/include/arm/arch-arm64.inc

##preferred providers
PREFERRED_PROVIDER_virtual/kernel = "linux-edision"
PREFERRED_PROVIDER_virtual/neutrino = "neutrino-mp"
PREFFERED_PROVIDER_virtual/libstb-hal = "libstb-hal"
PREFFERED_PROVIDER_virtual/dvb-driver = "edision-dvb-modules-${MACHINE}"
PREFFERED_PROVIDER_virtual/screengrabber = "grab"
PREFERRED_PROVIDER_virtual/egl ?= "edision-libv3d"
PREFERRED_PROVIDER_virtual/libgles2 ?= "edision-libv3d"

PREFERRED_VERSION_linux-libc-headers = "5.9"
```

## conf/machine/osmio4kplus.conf
```bitbake
#@TYPE: Machine
#@NAME: Edision OSMIO4K Plus
#@DESCRIPTION: Machine configuration for the Edision OSMIO4K Plus
#@MAINTAINER: Markus Volk

CHIPSET = "bcm72604"

MACHINE_KERNEL_PR = "r0"

MACHINE_FEATURES = "apm usbhost keyboard vfat ext2 wifi"

MACHINE_EXTRA_RRECOMMENDS += " \
	kernel-modules \
"

MACHINE_ESSENTIAL_EXTRA_RDEPENDS += "edision-dvb-modules-${MACHINE}"
MACHINE_ESSENTIAL_EXTRA_RDEPENDS += "edision-splash"
MACHINE_ESSENTIAL_EXTRA_RRECOMMENDS += "kernel-module-qca6174"
MACHINE_ESSENTIAL_EXTRA_RRECOMMENDS += "kernel-module-hci-uart"
MACHINE_ESSENTIAL_EXTRA_RRECOMMENDS += "kernel-module-btqca"
MACHINE_ESSENTIAL_EXTRA_RRECOMMENDS += "kernel-module-rt2800usb"
MACHINE_ESSENTIAL_EXTRA_RRECOMMENDS += "firmware-qca6174"

KERNEL_MODULE_AUTOLOAD += "hci_uart"
KERNEL_MODULE_AUTOLOAD += "wlan"

MACHINE_ESSENTIAL_EXTRA_RRECOMMENDS += " \
    bluez5 \
    pulseaudio-server \
    wpa-supplicant \
    "

require conf/machine/include/edision/edision-arm.inc
```
